## package/automake/Config.in
```kconfig
config BR2_PACKAGE_AUTOMAKE
	bool "automake"
	depends on BR2_PACKAGE_BASH
	depends on BR2_PACKAGE_AUTOCONF
	help
	  Tool for automatically generating Makefile's for input to
	  configure scripts (made by autoconf).

	  http://www.gnu.org/software/automake/
```

## package/bash/Config.in
```kconfig
config BR2_PACKAGE_BASH
	bool "bash"
	help
	  The standard GNU Bourne again shell.

	  http://cnswww.cns.cwru.edu/~chet/bash/bashtop.html
```

## package/dnsmasq/Config.in
```kconfig
config BR2_PACKAGE_DNSMASQ
	bool "dnsmasq"
	depends on BR2_USE_WCHAR
 	select BR2_PACKAGE_LIBIDN
 	select BR2_PACKAGE_GETTEXT if BR2_NEEDS_GETTEXT_IF_LOCALE
	help
	  A lightweight DNS and DHCP server.  It is intended to provide
	  coupled DNS and DHCP service to a LAN.

	  http://www.thekelleys.org.uk/dnsmasq/

config BR2_PACKAGE_DNSMASQ_TFTP
	bool "tftp support"
	default y
	depends on BR2_PACKAGE_DNSMASQ
	help
	  Enable TFTP support in dnsmasq.

config BR2_PACKAGE_DNSMASQ_DHCP
	bool "dhcp support"
	default y
	depends on BR2_PACKAGE_DNSMASQ
	help
	  Enable DHCP server support in dnsmasq.
```

## package/games/rubix/Config.in
```kconfig
config BR2_PACKAGE_RUBIX
	bool "rubix"
    depends on XLIB_LIBX11
	help
	  A 3D rubiks cube game for X

	  http://avr32linux.org/twiki/pub/Main/Rubix
```

## package/libglib2/Config.in
```kconfig
config BR2_PACKAGE_LIBGLIB2
	bool "libglib2"
	select BR2_PACKAGE_GETTEXT
	select BR2_PACKAGE_LIBICONV if !BR2_ENABLE_LOCALE
	select BR2_PACKAGE_ZLIB
	depends on BR2_USE_WCHAR # gettext
	help
	  Low-level core library that forms the basis of GTK+ and GNOME.

	  http://www.gtk.org/
```

## package/microperl/Config.in
```kconfig
config BR2_PACKAGE_MICROPERL
	bool "microperl"
	select BR2_PACKAGE_BUSYBOX
	select BR2_PACKAGE_BUSYBOX_SKELETON
	depends on BR2_PACKAGE_BASH
	depends on BR2_PACKAGE_AUTOCONF
	help
	  Perl without operating-specific functions such as readdir.

if BR2_PACKAGE_MICROPERL

config BR2_PACKAGE_MICROPERL_MODULES
	string "additional modules"
	help
	  List of space-separated microperl modules to copy to the rootfs.

	  Examples: warnings.pm Getopt/Std.pm Time::Local

	  Module dependencies are not automatic so check your needs.
	  You can't use XS modules like IO.

menu "module bundles"

config BR2_PACKAGE_MICROPERL_BUNDLE_CGI
	bool "CGI"
	help
	  Copy required modules to do CGI scripting.

endmenu

endif
```

## package/midori/Config.in
```kconfig
config BR2_PACKAGE_MIDORI
	bool "midori"
	select BR2_PACKAGE_WEBKIT
	select BR2_PACKAGE_LIBSEXY
	select BR2_PACKAGE_GETTEXT if BR2_NEEDS_GETTEXT_IF_LOCALE
	select BR2_PACKAGE_LIBICONV if !BR2_ENABLE_LOCALE
#	depends on BR2_PACKAGE_LIBGTK2
	depends on BR2_INSTALL_LIBSTDCPP # webkit
#	depends on BR2_PACKAGE_XORG7
	help
	  Midori is a lightweight web browser based on WebKit

	  http://software.twotoasts.de/?page=midori
```

## package/v86d/Config.in
```kconfig
config BR2_PACKAGE_V86D 
	bool "v86d" 
	depends on (BR2_i386 || BR2_x86_64) 
	help 
	 v86d is the userspace helper that runs x86 code in an emulated 
	 environment. uvesafb will not work without v86d. v86d currently 
	 supports the x86 and amd64 (x86-64) architectures. 
 
	 http://dev.gentoo.org/~spock/projects/uvesafb/
```

## package/x11r7/xkeyboard-config/Config.in
```kconfig
config BR2_PACKAGE_XKEYBOARD_CONFIG
	bool "xkeyboard-config"
	select BR2_PACKAGE_XAPP_XKBCOMP
    depends on BR2_USE_WCHAR
	help
	  keyboard configuration database for X

	  http://xlibs.freedesktop.org/xkbdesc
```

## toolchain/Config.in
```kconfig
menu "Toolchain"
choice
	prompt "Toolchain type"
	default BR2_TOOLCHAIN_BUILDROOT if !BR2_avr32
	default BR2_TOOLCHAIN_EXTERNAL_SOURCE if BR2_avr32
	help
	  Select whether to use the toolchain provided by buildroot
	  or an external toolchain.

	  Some vendors provide toolchains in binary form, some in
	  source form.

config BR2_TOOLCHAIN_BUILDROOT
	bool "Buildroot toolchain"
	depends on !BR2_avr32

config BR2_TOOLCHAIN_EXTERNAL
	bool "External binary toolchain"

config BR2_TOOLCHAIN_EXTERNAL_SOURCE
	bool "External source toolchain"
endchoice

config BR2_TOOLCHAIN_SOURCE
	bool
	default y if BR2_TOOLCHAIN_BUILDROOT || BR2_TOOLCHAIN_EXTERNAL_SOURCE
	default n if BR2_TOOLCHAIN_EXTERNAL

config BR2_NEEDS_GETTEXT
	bool
	default y if BR2_TOOLCHAIN_BUILDROOT
	default y if BR2_TOOLCHAIN_EXTERNAL_UCLIBC
	default y if BR2_TOOLCHAIN_CTNG_uClibc

config BR2_NEEDS_GETTEXT_IF_LOCALE
	bool
	default y if (BR2_NEEDS_GETTEXT && BR2_ENABLE_LOCALE)

config BR2_USE_MMU
	bool "Enable MMU support" if BR2_arm || BR2_armeb || BR2_mips || BR2_mipsel || BR2_sh || BR2_xtensa
	default y
	help
	  If your target has a MMU, you should say Y here.  If you
	  are unsure, just say Y.

source "target/device/Config.in.toolchain"

source "toolchain/Config.in.1"
source "toolchain/external-toolchain/Config.in"

# we want gdb config in the middle of both source and external
# toolchains, but mconf won't let us source the same file twice,
# so put it here instead
source "toolchain/gdb/Config.in"
comment "Common Toolchain Options"

source "toolchain/Config.in.2"
source "toolchain/external-toolchain/Config.in.2"
source "toolchain/toolchain-common.in"

config BR2_TOOLCHAIN_HAS_THREADS
	bool
	default y if (BR2_PTHREADS || BR2_PTHREADS_OLD || BR2_PTHREADS_NATIVE)

endmenu
```
